
const uint8_t Camaro_Logo_RLE[] PROGMEM = {
0x7F, 0x7F, 0x6B, 0x3F, 0x11, 0x44, 0x3F, 0x11, 0x44, 0x3F, 0x11, 0x44, 0x3F, 0x11, 0x44, 0x3F, 
0x11, 0x44, 0x3F, 0x11, 0x44, 0x3F, 0x11, 0x44, 0x08, 0x90, 0x08, 0x51, 0x07, 0xD0, 0x08, 0x44, 
0x08, 0x90, 0x08, 0x51, 0x07, 0xD0, 0x08, 0x44, 0x08, 0x90, 0x08, 0x51, 0x07, 0xD0, 0x08, 0x44, 
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0x43, 0x02, 0x44, 0x3F, 0x0D, 0xC1, 0x45, 0x3F, 0x11, 0xC1, 0x41, 0x29
};

const uint8_t Camaro_RLE[] PROGMEM = {
0x3A, 0xC4, 0x75, 0xC4, 0x3F, 0x2B, 0xC1, 0x7F, 0x53, 0x3F, 0x1F, 0x64, 0xD3, 0x60, 0x3F, 0x1C, 
0x45, 0xC1, 0x03, 0xC4, 0x7F, 0x41, 0xC4, 0x03, 0x46, 0x3F, 0x19, 0x44, 0xC1, 0x42, 0x01, 0x4F, 
0xC4, 0x23, 0xC4, 0x51, 0xC1, 0x01, 0x41, 0xC2, 0x43, 0x3F, 0x18, 0x43, 0xC2, 0x43, 0x01, 0x43, 
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0x3F, 0x02, 0x6D, 0x3F, 0x3F, 0x12, 0x5A, 0x3F, 0x0C
};

uint16_t decodeColor(uint8_t val) {
  switch (val) {
    case 1: return 0xFFFF;
    case 2: return 0xD922;
    case 3: return 0x28AE;
    default: return 0x0000;
  }
}

void drawRLEImage(const uint8_t *data, size_t dataSize, uint8_t w, uint8_t h, uint8_t oX, uint8_t oY, bool main = true) {
  uint8_t x = 0;
  uint8_t y = 0;
  uint16_t i = 0;

  while (i < dataSize) {
    uint8_t entry = pgm_read_byte(&data[i++]);
    uint8_t val = entry >> 6;
    uint8_t count = entry & 0x3F;
    uint16_t color = decodeColor(val);

    for (uint8_t c = 0; c < count; c++) {
      if (main) {
tft.drawPixel(x + oX, y + oY, color);
      } else {
tft2.drawPixel(x + oX, y + oY, color);
      }
      
      x++;
      if (x >= w) {
        x = 0;
        y++;
      }
    }
  }
}
void drawStartScreen(){
tft2.fillScreen(GC9A01A_BLACK);
  drawRLEImage(Camaro_Logo_RLE, sizeof(Camaro_Logo_RLE), 84, 180, (240-84)/2, (240-180)/2, false);
  tft2.setTextSize(3);
  tft2.setTextColor(GC9A01A_WHITE);
  tft2.setCursor(95, 215); tft2.println("LS1");
  tft2.setCursor(52, 35); tft2.print("C");
  tft2.setCursor(175, 35); tft2.print("C");
  tft2.setCursor(52, 66); tft2.print("H");
  tft2.setCursor(175, 60); tft2.print("A");
  tft2.setCursor(52, 97); tft2.print("E");
  tft2.setCursor(175, 85); tft2.print("M");
  tft2.setCursor(52, 129); tft2.print("V");
  tft2.setCursor(175, 110); tft2.print("A");
  tft2.setCursor(52, 160); tft2.print("Y");
  tft2.setCursor(175, 135); tft2.print("R");
  tft2.setCursor(175, 160); tft2.print("O");
}
void drawCamaroLogo() {
  drawStartScreen();
  tft.fillScreen(GC9A01A_BLACK);
  drawRLEImage(Camaro_RLE, sizeof(Camaro_RLE), 179, 220, (240-179)/2, (240-220)/2);
  //delay(2000);
  
  
}


